## firmware/gun-controller/main/Kconfig.projbuild
```kconfig
menu "GunGame debug options"
    config GG_DEBUG_NO_USB_HID
        bool "Disable USB HID to retain built-in USB JTAG"
        default n
        help
            Build a disconnected HID stub instead of installing TinyUSB.
            Use only for sensor/algorithm/button debugging, not gameplay.
endmenu
```

## firmware/pedal-controller/main/Kconfig.projbuild
```kconfig
menu "GunGame debug options"
    config GG_DEBUG_NO_USB_HID
        bool "Disable USB HID to retain built-in USB JTAG"
        default n
        help
            Build a disconnected HID stub instead of installing TinyUSB.
            Use only for input debugging, not gameplay.
endmenu
```

## firmware/pedal-controller/sdkconfig.defaults.hid
```kconfig
# Normal gameplay build.
# CONFIG_GG_DEBUG_NO_USB_HID is not set
CONFIG_COMPILER_OPTIMIZATION_PERF=y
```
